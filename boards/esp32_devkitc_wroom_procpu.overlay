/*
 * Copyright (c) 2022 Espressif Systems (Shanghai) Co., Ltd.
 *
 * SPDX-License-Identifier: Apache-2.0
 */

&wifi {
	status = "okay";
};

&esp32_bt_hci {
	status = "disabled";
};

&psram0 {
	status = "okay";
};
