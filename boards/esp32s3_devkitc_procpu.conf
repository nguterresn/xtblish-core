## boards/esp32s3_devkitc_procpu.conf
```kconfig
# ESP32 WIFI
# Optional.
# CONFIG_ESP32_WIFI_STA_AUTO_DHCPV4=y

# ESP32 PSRAM
CONFIG_ESP_SPIRAM=y
CONFIG_ESP_SPIRAM_HEAP_SIZE=262134
CONFIG_SPIRAM_MODE_OCT=y
# CONFIG_ESP32_WIFI_NET_ALLOC_SPIRAM=y
CONFIG_SPIRAM_TYPE_ESPPSRAM64=y
```

## west.yml
```yaml
manifest:

  projects:
    - name: zephyr
      revision: v3.7.1
      path: zephyr
      url: https://github.com/zephyrproject-rtos/zephyr.git
      import:
        name-allowlist:
          - cmsis
          - hal_xtensa
          - hal_espressif
          - lvgl
          - mbedtls
          - mcuboot
          - trusted-firmware-m
          - net-tools

    - name: wasm-micro-runtime
      revision: main
      path: wasm-zephyr-ota/libs/wasm-micro-runtime
      url: https://github.com/bytecodealliance/wasm-micro-runtime.git

  self:
    path: wasm-zephyr-ota
```
